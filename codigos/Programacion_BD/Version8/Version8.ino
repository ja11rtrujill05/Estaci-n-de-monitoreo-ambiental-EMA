//---------Archivo de configuracion-----------//
#include "confi.h"

//-----------COORDENADAS-------------------//

String latid;
String longi;

float latitud1;
float longitud1;
//-------------- perro guardian--------------//

const int watchdogTimeout = 2000; //tiempo en milisegundos

//--------------Puertos,dirreciones y oled------------//

// #define rx 25 //Sensor PM - Cable Verde
// #define tx 26 //Sensor PM - Cable Amarillo

SerialPM pms(PMSx003, 25, 26);  // PMSx003, RX, TX
#define TXC 19 //Sensr Co2
#define RXC 18 // Sensor Co2
#define VEML6075_ADDR   0x10
#define i2c_Address 0x3c //initialize with the I2C addr 0x3C Typically eBay OLED's
#define SCREEN_WIDTH 128 // OLED display width, in pixels
#define SCREEN_HEIGHT 64 // OLED display height, in pixels
#define OLED_RESET -1   //   QT-PY / XIAO

//----------objetos de liberias--------//
SoftwareSerial mySerial(RXC, TXC); //El puerto serial que va a permitir la comunicacion entre el ordenador el sensor de CO2 estará fijando 
//SoftwareSerial ZHSerial(rx, tx); // RX, TX
//SD_ZH03B ZH03B( ZHSerial, SD_ZH03B::SENSOR_ZH03B );  // same as the line above
HTU21D myHumidity; // create object
DFRobot_VEML6075_IIC VEML6075(&Wire, VEML6075_ADDR);  // create object
Adafruit_SH1106G display = Adafruit_SH1106G(SCREEN_WIDTH, SCREEN_HEIGHT, &Wire, OLED_RESET);
MHZ19 myMHZ19;
WiFiManager wm; //Crea una instancia de la clase WiFiManager para manejar la conexión Wi-Fi
FirebaseData firebaseData; //Crea una instancia de la clase FirebaseData para manejar la conexión con Firebase

//----------------Variables-----------------//
RTC_DATA_ATTR bool pantalla = true;
int PM1;
int PM25;
int PM10;
int bat=0;
unsigned int PM=0;
String N="";
float humd;
float Temp;
static int CO2=0; //variable CO2=0
/*
  uint16_t    UvaRaw;        // read UVA raw
  uint16_t    UvbRaw;        // read UVB raw
  uint16_t    comp1Raw; // read COMP1 raw
  uint16_t    comp2Raw;   // read COMP2 raw
*/
float Uva;                   // get UVA
float Uvb;                   // get UVB
float Uvi;            // get UV index
String rute1= "Datos"; //Carpeta donde se guardaran los datos en Firebase
//-----------------Logos------------------//

static const unsigned char PROGMEM LOGObmp[] =
{// 'fondo ERA', 128x64px
0x00, 0x00, 0x00, 0x00, 0x00, 0x00, 0x00, 0x00, 0x00, 0x00, 0x00, 0x00, 0x00, 0x00, 0x00, 0x00, 
0x00, 0x00, 0x00, 0x00, 0x00, 0x00, 0x00, 0x00, 0x00, 0x00, 0x00, 0x00, 0x00, 0x00, 0x00, 0x00, 
0x00, 0x00, 0x00, 0x00, 0x00, 0x00, 0x00, 0x00, 0x00, 0x00, 0x00, 0x00, 0x00, 0x00, 0x00, 0x00, 
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0x00, 0x00, 0x00, 0x00, 0x00, 0x00, 0x00, 0x00, 0x00, 0x00, 0x00, 0x00, 0x00, 0x00, 0x00, 0x00
};
static const unsigned char PROGMEM CO2bmp[] =
{// 'fondo', 128x64px
0x00, 0x00, 0x00, 0x00, 0x00, 0x00, 0x00, 0x00, 0x00, 0x00, 0x00, 0x00, 0x00, 0x00, 0x00, 0x00, 
  0x00, 0x00, 0x00, 0x00, 0xfe, 0x00, 0x00, 0x00, 0x00, 0x00, 0x00, 0x01, 0x01, 0x00, 0x00, 0x00, 
  0x00, 0x00, 0x00, 0x02, 0x00, 0x00, 0x00, 0x00, 0x00, 0x00, 0x00, 0x04, 0x00, 0x40, 0x00, 0x00, 
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  0x00, 0x00, 0x00, 0x00, 0x00, 0x00, 0x00, 0x00, 0x00, 0x00, 0x00, 0x00, 0x00, 0x00, 0x00, 0x00
};
static const unsigned char PROGMEM HUMbmp[] =
{// 'fondo', 128x64px
0x00, 0x00, 0x00, 0x00, 0x20, 0x00, 0x00, 0x00, 0x00, 0x00, 0x00, 0x00, 0x50, 0x00, 0x00, 0x00, 
  0x00, 0x00, 0x00, 0x00, 0xd8, 0x00, 0x00, 0x00, 0x00, 0x00, 0x00, 0x00, 0x88, 0x00, 0x00, 0x00, 
  0x00, 0x00, 0x00, 0x01, 0x04, 0x00, 0x00, 0x00, 0x00, 0x00, 0x00, 0x01, 0x04, 0x00, 0x00, 0x00, 
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  0x00, 0x00, 0x01, 0x83, 0x80, 0x00, 0x00, 0x00, 0x00, 0x00, 0x00, 0x7e, 0x00, 0x00, 0x00, 0x00
};
static const unsigned char PROGMEM UVbmp[] =
{// 'fondo', 128x64px
0x00, 0x00, 0x00, 0x00, 0x00, 0x00, 0x00, 0x00, 0x00, 0x00, 0x00, 0x00, 0x00, 0x00, 0x00, 0x00, 
  0x00, 0x00, 0x00, 0xe0, 0x00, 0x00, 0x00, 0x00, 0x00, 0x00, 0x00, 0x90, 0x00, 0x00, 0x00, 0x00, 
  0x00, 0x00, 0x13, 0x0f, 0x80, 0xc0, 0x00, 0x00, 0x00, 0x00, 0x10, 0x60, 0x81, 0x60, 0x00, 0x00, 
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  0x00, 0x00, 0x00, 0x00, 0x00, 0x00, 0x00, 0x00, 0x00, 0x00, 0x00, 0x00, 0x00, 0x00, 0x00, 0x00 
  
};
static const unsigned char PROGMEM PMbmp[] =
{// 'fondo', 128x64px
0x00, 0x00, 0x00, 0x00, 0xe0, 0x00, 0x00, 0x00, 0x00, 0x00, 0x00, 0x07, 0xfc, 0x00, 0x00, 0x00, 
  0x00, 0x00, 0x00, 0x0f, 0xf6, 0x00, 0x00, 0x00, 0x00, 0x00, 0x00, 0x08, 0x02, 0x00, 0x00, 0x00, 
  0x00, 0x00, 0x00, 0x18, 0x36, 0x00, 0x00, 0x00, 0x00, 0x00, 0x00, 0x70, 0x1f, 0x00, 0x00, 0x00, 
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  0x00, 0x00, 0x00, 0x1c, 0x1c, 0x00, 0x00, 0x00, 0x00, 0x00, 0x00, 0x03, 0xf0, 0x00, 0x00, 0x00
};
static const unsigned char PROGMEM TEMbmp[] =
{// 'fondo', 128x64px
0x00, 0x00, 0x03, 0xc0, 0x00, 0x00, 0x00, 0x00, 0x00, 0x00, 0x0e, 0x70, 0x00, 0x00, 0x00, 0x00, 
  0x00, 0x00, 0x1b, 0xd8, 0x00, 0x00, 0x00, 0x00, 0x00, 0x00, 0x1f, 0x68, 0x01, 0x00, 0x00, 0x00, 
  0x00, 0x00, 0x14, 0x28, 0x01, 0x00, 0x00, 0x00, 0x00, 0x00, 0x14, 0x78, 0x60, 0x08, 0x00, 0x00, 
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  0x00, 0x00, 0x1e, 0x78, 0x00, 0x00, 0x00, 0x00, 0x00, 0x00, 0x07, 0xe0, 0x00, 0x00, 0x00, 0x00
};

static const unsigned char PROGMEM UBIbmp[] =
{// 'fondo', 128x64px
0x00, 0x00, 0x00, 0x1f, 0x80, 0x00, 0x00, 0x00, 0x00, 0x00, 0x00, 0x7f, 0xe0, 0x00, 0x00, 0x00, 
  0x00, 0x00, 0x00, 0xff, 0xf0, 0x00, 0x00, 0x00, 0x00, 0x00, 0x01, 0xff, 0xf8, 0x00, 0x00, 0x00, 
  0x00, 0x00, 0x03, 0xff, 0xfc, 0x00, 0x00, 0x00, 0x00, 0x00, 0x03, 0xf0, 0xfc, 0x00, 0x00, 0x00, 
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  0x00, 0x00, 0x1f, 0xff, 0xff, 0x80, 0x00, 0x00, 0x00, 0x00, 0x01, 0xff, 0xf8, 0x00, 0x00, 0x00
};

//----------------------Inicio Setup----------------------//
void iniciar();
void testdrawchar();

void setup() {
  
  Serial.begin(115200); //Inicia la comunicación serial a 115200 baudios
  pinMode(4,INPUT); //Pulsadores
  esp_task_wdt_init(watchdogTimeout, true);
  // Habilita el watchdog de tareas
  esp_task_wdt_add(NULL);
}//---------Fin Setup-----------//

//------------Inicio LOOP----------//

void loop() {
  iniciar();
  io.run();
  /*
  UvaRaw = VEML6075.readUvaRaw();         // read UVA raw
  UvbRaw = VEML6075.readUvbRaw();         // read UVB raw
  comp1Raw = VEML6075.readUvComp1Raw();   // read COMP1 raw
  comp2Raw = VEML6075.readUvComp2Raw();   // read COMP2 raw
*/
    //-----------Obtencion Data Co2-------//
    
    CO2 = myMHZ19.getCO2(); //Toma el Valor de ppm
    
    //-----------Obtencion Data PM-------//
    pms.read();
 //   ZH03B.readData();
    PM1=pms.pm01;
    PM25=pms.pm25;
    PM10=pms.pm10;

    //--------------Obtencion UV-----------//
  
    Uva = VEML6075.getUva();                    // get UVA
    Uvb = VEML6075.getUvb();                    // get UVB
    Uvi = VEML6075.getUvi(Uva, Uvb);            // get UV index
   // Uvi=VEML6075.uvi2mwpcm2(Uvi);
    //Obtencion Temperatura y Humedad--------//
  
    humd = myHumidity.readHumidity();
    Temp = myHumidity.readTemperature();

    //----------Envio de Datos FireBase------------//
  
      N=String(humd,2); //se usa para enviar Cadenas en vez de float
    Firebase.setString(firebaseData,rute1+"/humedad",N); //Humedad
    Firebase.setInt(firebaseData,rute1+"/PM1", PM1); //Revisar PM 1
    Firebase.setInt(firebaseData,rute1+"/PM2_5", PM25); //Revisar PM 2.5
    Firebase.setInt(firebaseData,rute1+"/PM10", PM10); //Revisar PM 10
    Firebase.setInt(firebaseData,rute1+"/CO2",CO2); //CO2
      N=String(Uvi,2);
    Firebase.setString(firebaseData,rute1+  "/UV",N); // "Rediacion UV"
      N=String(Temp,2);
    Firebase.setString(firebaseData,rute1+  "/temperatura",N);// "temperatura"
    
    //----------Toma los Datos de Coordenadas-------//

    Firebase.getString(firebaseData,F("/Datos/Latitud"),&latid);
    Firebase.getString(firebaseData,F("/Datos/Longitud"),&longi);
    latid=latid.substring(2,(latid.length()-2));
    longi=longi.substring(2,(longi.length()-2));
    latitud1=latid.toFloat();
    //Serial.println(latid);
    longitud1=longi.toFloat();
    //---------Envio de Datos Adafruid IO-------//
    
    temperatura->save(Temp);
    humedad->save(humd);
    co2->save(CO2);
    pm1->save(PM1);
    pm10->save(PM10);
    pm25->save(PM25);
    uv->save(Uvi);
    bateria->save(bat);
    ubi->save("Estacion Meteo EVA",latitud1,longitud1);
    bat=random(0,100);
    
    //---------Imprimir en OLED-----------------//
   
   for(int a=0;a<=4;a++){// cada ciclo es de 15s aprox
     display.clearDisplay();
     if(pantalla==true){
      testdrawchar();
     }
   }
    //-------------- Tiempo de Deep Sleep ------------//
   esp_sleep_enable_ext0_wakeup(GPIO_NUM_4, 1); 
   esp_sleep_enable_timer_wakeup( (60*4)* 1000000); // Tiempor que dormira
   esp_deep_sleep_start(); //tiempo de despertar
   
}//----------Fin LOOP------------------//


// Funciones

void testdrawchar() {
  display.setTextSize(1);
  display.setTextColor(SH110X_WHITE);
  display.drawBitmap(-15,0, CO2bmp, 64, 32, SH110X_WHITE);
  display.setCursor(44, 12);
  display.write("Co2:");
  display.print(CO2);
  display.write(" ppm");
  display.drawBitmap(-15,32, TEMbmp, 64, 32, SH110X_WHITE);
  display.setCursor(44, 42);
  display.write("Tem:");
  display.print(Temp);
  display.write(" °C");
  display.display();
       delay(5000);
  display.clearDisplay();
  display.drawBitmap(-15,0, PMbmp, 64, 32, SH110X_WHITE);
  display.setCursor(39, 2);
  display.write("PM1:");
  display.print(PM1);
  display.write(" ug/m3");
  display.setCursor(39, 12);
  display.write("PM2.5:");
  display.print(PM25);
  display.write(" ug/m3");
  display.setCursor(39, 21);
  display.write("PM10:");
  display.print(PM10);
  display.write(" ug/m3");
  display.drawBitmap(-15,32, UVbmp, 64, 32, SH110X_WHITE);
  display.setCursor(44, 40);
  display.write("UV:");
  display.print(Uvi,3);
  display.write(" IUV");
  display.display();
       delay(5000);
  display.clearDisplay();
  display.drawBitmap(-15,0, HUMbmp, 64, 32, SH110X_WHITE);
  display.setCursor(39, 12);
  display.write("HR:");
  display.print(humd);
  display.write(" %");
  display.drawBitmap(-15,34, UBIbmp, 64, 32, SH110X_WHITE);
  display.setCursor(39, 40);
  display.write("LAT:");
  display.print(latitud1);
  display.setCursor(39, 55);
  display.write("LON:");
  display.print(longitud1);
  display.display();
       delay(5000);
}
void iniciar(){
  pms.init();                   // config serial port
  
  //----------OLED-------------------//
  
  delay(100); // wait for the OLED to power up
  display.begin(i2c_Address, true); // Address 0x3C defaultdisplay
  display.display();
  delay(500);
  
  //-----Muestra Logo ERA ----------//
  
  display.clearDisplay();
  display.drawBitmap(0,0, LOGObmp, 128, 64, SH110X_WHITE);
  display.display();
  delay(1000);
  display.clearDisplay();
  
  //---------Configuracion WIFI-----------//
  
      bool res;
      res = wm.autoConnect("EMA V8"); // anonymous ap
      if(!res) {
        Serial.println("Failed to connect");
        ESP.restart();
      }//Fin if 
      else {
        //if you get here you have connected to the WiFi    
        Serial.println("connected...yeey :)");
      }//Fin else
    
  //--------Configuracion FireBase----------//

  Firebase.begin(FIREBASE_HOST, FIREBASE_AUTH); //Inicia la conexión con Firebase

  //------------Configuracion CO2----------//
  
  mySerial.begin(9600);
  myMHZ19.begin(mySerial);
  myMHZ19.autoCalibration(false);                              // Turn auto calibration ON (OFF autoCalibration(false))

  //-------Configuracion Temperatura y Humedad-------//
  
  while(!Serial);
  myHumidity.begin();

  //------------Configuracion UV---------------//
  
  while(VEML6075.begin() != true) {
    Serial.println("VEML6075 begin faild");
    delay(500);
  }
  Serial.println("VEML6075 begin successed");

  //--------Configuracion Adafruid IO---------//
  
  Serial.printf("Connecting to Adafruit IO with User: %s Key: %s.\n", IO_USERNAME, IO_KEY);
  io.connect();
  while ((io.status() < AIO_CONNECTED))
    {
      Serial.print(".");
      delay(500);
    }
   Serial.println("Connected to Adafruit IO.");
}

void tarea1( void * parameter )                                                                                               
                                      {
                                        for (;;) {
                                                  int a=analogRead(4);                                                                 
                                                  if(a<=1200 && a>=150){
                                                  pantalla=!pantalla;
                                                  delay(250);
                                                  esp_task_wdt_reset();
                                                  }
                                                  }
                                      }
